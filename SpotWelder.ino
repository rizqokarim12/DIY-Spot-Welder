#include <Wire.h>
#include <Adafruit_SSD1306.h>
#include <OneButton.h>
#include <EEPROM.h>
Adafruit_SSD1306 display(128, 64, &Wire, 4);

const unsigned char ManualDisplay [] PROGMEM = {
	0x00, 0x00, 0x00, 0x00, 0x00, 0x00, 0x00, 0x00, 0x00, 0x00, 0x00, 0x00, 0x00, 0x00, 0x00, 0x00, 
	0x00, 0x00, 0x00, 0x00, 0x00, 0x00, 0x00, 0x00, 0x00, 0x00, 0x00, 0x00, 0x00, 0x00, 0x00, 0x00, 
	0x00, 0x00, 0x00, 0x00, 0x00, 0x00, 0x00, 0x00, 0x00, 0x00, 0x00, 0x00, 0x00, 0x00, 0x00, 0x00, 
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	0x3f, 0xff, 0xff, 0xff, 0xff, 0xff, 0xff, 0xff, 0xff, 0xff, 0xff, 0xff, 0xff, 0xff, 0xff, 0xfc
};

const unsigned char AutoDisplay [] PROGMEM = {
	0x00, 0x00, 0x00, 0x00, 0x00, 0x00, 0x00, 0x00, 0x00, 0x00, 0x00, 0x00, 0x00, 0x00, 0x00, 0x00, 
	0x00, 0x00, 0x00, 0x00, 0x00, 0x00, 0x00, 0x00, 0x00, 0x00, 0x00, 0x00, 0x00, 0x00, 0x00, 0x00, 
	0x00, 0x00, 0x00, 0x00, 0x00, 0x00, 0x00, 0x00, 0x00, 0x00, 0x00, 0x00, 0x00, 0x00, 0x00, 0x00, 
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	0x3f, 0xff, 0xff, 0xff, 0xff, 0xff, 0xff, 0xff, 0xff, 0xff, 0xff, 0xff, 0xff, 0xff, 0xff, 0xfc
};

int A = 3;
int B = 6;
int currentStateA;
int previousStateA; 
OneButton push(5, true);
bool screen = 0;
int pulse;
bool mode;
int previousPulse;
const int FootSwitch = 4;
int rotate;
bool prevState = HIGH;
int weld1 = 9;
int Connectivity = 8;
bool prevWeldState = LOW;
bool weldActionTriggered = false; 
unsigned long weldStartTime = 0;
int threshold = 1500;
bool weldState;
void setup() {
  Serial.begin(9600);
  pinMode (A,INPUT_PULLUP);
  pinMode (B,INPUT_PULLUP);
  pinMode(weld1, OUTPUT);
  pinMode(FootSwitch, INPUT_PULLUP);
  previousStateA = digitalRead(A);
  push.attachClick(click1);
  push.attachLongPressStart(click2);
  pulse = EEPROM.read(1);
  mode = EEPROM.read(2);
  pinMode(Connectivity, INPUT_PULLUP);
  attachInterrupt(digitalPinToInterrupt(A), EncoderRead, CHANGE);
    if (!display.begin(SSD1306_SWITCHCAPVCC, 0x3C)) 
  {
    Serial.println(F("SSD1306 allocation failed"));
    for (;;);
  }
  display.clearDisplay(); 
  analogReference(INTERNAL);
}

void loop() {
  currentStateA = digitalRead(A);
  push.tick();
  if (screen == 1) {
    menu1();
    saveMode();
  } 
  if (screen == 0) {
    normal();
    savePulse();
    if(mode == 1){
      manual();
    }
    else{
      Auto();
    }
  }
  Serial.println(digitalRead(Connectivity));
}

void savePulse(){ 
  if (EEPROM.read(1) != pulse){
    EEPROM.write(1, pulse);
  }
}
void saveMode(){
  if(EEPROM.read(2) != mode){
    EEPROM.write(2, mode);
  }
}
void EncoderRead(){
   if (currentStateA != previousStateA){ 
     if (digitalRead(B) != currentStateA) { 
       pulse --;
       previousPulse = pulse + 1;
     } 
     if(digitalRead(B) == currentStateA) {
       pulse ++;    
       previousPulse = pulse - 1;  
     }
   } 
   previousStateA = currentStateA;
   if(pulse < 1){
    pulse = 1;
   }
   if(pulse >= 30){
    pulse = 30;
   }
}

void menu1(){
    if (currentStateA != previousStateA){ 
      mode = !mode;
    }
    previousStateA = currentStateA;
    display.clearDisplay();
    if(previousPulse != pulse && mode == 1){
      display.setTextColor(WHITE);
      display.setTextSize(2);
      display.setCursor(0, 0);
      display.print("Mode:");
      display.drawBitmap(0, 0, ManualDisplay, 128, 64, 1);
    } 
    else {
      display.setTextColor(WHITE);
      display.setTextSize(2);
      display.setCursor(0, 0);
      display.print("Mode:");
      display.drawBitmap(0, 0, AutoDisplay, 128, 64, 1);
    }
    display.display();
}

void click1(){
  screen = 0;
}

void click2(){
  screen = 1;
}

void normal(){
  if (screen == 0 || currentStateA != previousStateA) {
    display.clearDisplay();
    display.setTextColor(WHITE);
    display.setTextSize(4);
    display.setCursor(27, 30);
    display.print(pulse);
    display.setTextColor(WHITE);
    display.setTextSize(3);
    display.setCursor(58, 38);
    display.print(" ms");
    if(mode == 1){
      display.setTextColor(WHITE);
      display.setTextSize(2);
      display.setCursor(55, 0);
      display.print("Manual");
    }
    else{
      display.setTextColor(WHITE);
      display.setTextSize(2);
      display.setCursor(55, 0);
      display.print("Auto");
    }
    display.display();
  }
}

void manual(){
    bool state = digitalRead(FootSwitch);
      if (state == LOW && prevState == HIGH) {
    digitalWrite(weld1, HIGH);
    delay(pulse);
    digitalWrite(weld1, LOW);
  }
  prevState = state;
}

void Auto(){
  weldState = digitalRead(Connectivity);
  if (weldState == HIGH && prevWeldState == LOW) {
    weldStartTime = millis(); 
    weldActionTriggered = false; 
  }
  if (weldState == HIGH && (millis() - weldStartTime > threshold) && !weldActionTriggered) {
    digitalWrite(weld1, HIGH);
    delay(pulse); 
    digitalWrite(weld1, LOW);
    weldActionTriggered = true; 
  }
  if (weldState == LOW) {
    weldStartTime = 0;
    weldActionTriggered = false;
  }
  prevWeldState = weldState;
}
